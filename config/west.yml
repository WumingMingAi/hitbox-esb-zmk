## config/west.yml
```yaml
manifest:
  defaults:
    revision: v0.3
  remotes:
    - name: zmkfirmware
      url-base: https://github.com/zmkfirmware
    - name: badjeff
      url-base: https://github.com/badjeff
  projects:
    - name: zmk
      remote: zmkfirmware
      import: app/west.yml
    - name: zmk-feature-split-esb
      remote: badjeff
      revision: main
      path: modules/zmk-feature-split-esb
  self:
    path: config
```
