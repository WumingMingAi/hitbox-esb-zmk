/ {
    chosen {
        zmk,kscan = &mock_kscan;
    };

    mock_kscan: mock_kscan {
        compatible = "zmk,kscan-mock";
        /* Dongle 没有物理按键，此处不定义行列 */
    };
};

/* ESB 地址必须与主控完全一致 */
/ {
    esb_split {
        compatible = "zmk,esb-split";
        base-addr-0 = <0xE7 0xE7 0xE7 0xE7>;
        base-addr-1 = <0xC2 0xC2 0xC2 0xC2>;
        addr-prefix = <0xE7>;
    };
};
